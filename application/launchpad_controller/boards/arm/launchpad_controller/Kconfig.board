## application/launchpad_controller/boards/arm/launchpad_controller/Kconfig.defconfig
```kconfig
# STM32H723ZG Nucleo board configuration

# Copyright (c) 2020 Alexander Kozhinov <AlexanderKozhinov@yandex.com>
# SPDX-License-Identifier: Apache-2.0

if BOARD_LAUNCHPAD_CONTROLLER

config BOARD
	default "launchpad_controller"

if NETWORKING

config NET_L2_ETHERNET
	default y

endif # NETWORKING

config USB_DC_HAS_HS_SUPPORT
	default y
	depends on USB_DC_STM32

config SYS_CLOCK_HW_CYCLES_PER_SEC
	int
	default 550000000
	depends on RTOS_TIMER && BOARD_MEC1501MODULAR_ASSY6885

endif # BOARD_LAUNCHPAD_CONTROLLER
```

## application/launchpad_controller/boards/arm/launchpad_controller/Kconfig.launchpad_controller
```kconfig
# Copyright (c) 2020 Alexander Kozhinov <AlexanderKozhinov@yandex.com>
# SPDX-License-Identifier: Apache-2.0

config BOARD_LAUNCHPAD_CONTROLLER
	bool "Launchpad Controller"
	select SOC_STM32H723XX
```

## application/launchpad_controller/boards/arm/launchpad_controller/board.yml
```yaml
board:
  name: launchpad_controller
  vendor: st
  socs:
    - name: stm32h723xx
```

## application/launchpad_controller/boards/arm/launchpad_controller/launchpad_controller_defconfig
```kconfig
# SPDX-License-Identifier: Apache-2.0

# CONFIG_SOC_SERIES_STM32H7X=y
# CONFIG_SOC_STM32H723XX=y


# Enable MPU
CONFIG_ARM_MPU=y

# Enable HW stack protection
CONFIG_HW_STACK_PROTECTION=y

# Enable UART
# CONFIG_SERIAL=y

# Console
CONFIG_LOG=y
CONFIG_LOG_BACKEND_UART=y
# CONFIG_LOG_BACKEND_SWO=y
# CONFIG_LOG_DEFAULT_LEVEL=4
# CONFIG_LOG_BACKEND_SWO_FREQ_HZ=16000000
# CONFIG_LOG_PRINTK=y
# CONFIG_LOG_MODE_IMMEDIATE=y
# CONFIG_LOG_PROCESS_THREAD=y
# CONFIG_LOG_IMMEDIATE=y
# CONFIG_UART_CONSOLE=n

# Enable MCO
CONFIG_CLOCK_STM32_MCO1_SRC_HSE=y
# CONFIG_CLOCK_STM32_MCO1_SRC_HSI=y
# CONFIG_CLOCK_STM32_MCO1_SRC_LSI=y
# CONFIG_CLOCK_STM32_MCO2_SRC_LSI=y
# CONFIG_CLOCK_STM32_MCO2_SRC_LSI=y


# CONFIG_CLOCK_STM32_MCO1_SRC_PLLQCLK=y

# Enable GPIO
CONFIG_GPIO=y

# Enable SPI
CONFIG_SPI=y

# Enable Clock
CONFIG_CLOCK_CONTROL=y
CONFIG_CLOCK_CONTROL_STM32_CUBE=y

# enable pin controller
CONFIG_PINCTRL=y

CONFIG_HW_STACK_PROTECTION=y

CONFIG_SERIAL=y
# CONFIG_UART_INTERRUPT_DRIVEN=y
CONFIG_CONSOLE=y
CONFIG_UART_CONSOLE=y
```

## application/launchpad_controller/modules/ad4111/Kconfig
```kconfig
config AD4111
	bool "AD4111 ADC"
	default y
	depends on DT_HAS_ANALOG_AD4111_ENABLED
	select SPI
	help
		Enable AD4111 ADC driver.

config AD4111_DUMMY
	bool "AD4111 ADC Dummy driver"
	default y
	depends on DT_HAS_ANALOG_AD4111_DUMMY_ENABLED
	help
		Enable AD4111 ADC dummy driver.
```

## application/launchpad_controller/modules/ad4111/dts/bindings/adc/analog,ad4111.yaml
```yaml
# Bindings for AD4111 Analog to Digital Converter (ADC)
# SPDX-License-Identifier: MIT
# Author: Love Mitteregger
# Date: 2024-06-12

description: Analog to Digital Converter (ADC) driver

compatible: "analog,ad4111"

include: spi-device.yaml


# This is already defined in the spi-device bindings, so commenting.
# on-bus: spi

# properties:
#   reg:
#     required: true
#     description: |
#       SPI chip select SET THIS TO TRUE WHEN BUILD WORKS

#   spi-max-frequency:
#     type: int
#     required: true
#     description: |
#       Maximum SPI clocking speed in Hz
```

## application/launchpad_controller/modules/ad4111/dts/bindings/adc/analog,ad4111_dummy.yaml
```yaml
# Bindings for AD4111 Analog to Digital Converter (ADC)
# SPDX-License-Identifier: MIT
# Author: Love Mitteregger
# Date: 2024-06-12

description: Analog to Digital Converter (ADC) driver

compatible: "analog,ad4111-dummy"
```

## application/launchpad_controller/modules/drivers/dts/Kconfig.ad4111
```kconfig
config ADC_AD4111
    bool "Analog Devices AD4111 ADC"
    select ADC
    select SPI
    help
      Enable support for the Analog Devices AD4111 ADC.
```

## application/launchpad_controller/modules/drivers/dts/bindings/adc/analog,ad4111.yaml
```yaml
# Bindings for AD4111 Analog to Digital Converter (ADC)
# SPDX-License-Identifier: MIT
# Author: Love Mitteregger
# Date: 2024-06-12

description: Analog to Digital Converter (ADC) driver

compatible: "analog,ad4111"

include: spi-device.yaml

properties:
  label:
    type: string
    required: false
    description: |
      User label for the device

  reg:
    required: false
    description: |
      SPI chip select SET THIS TO TRUE WHEN BUILD WORKS

  zephyr,init-priority:
    type: int
    description: Initialization priority for the ADC
    default: 50
      
  spi:
    type: phandle
    required: true
    description: |
      SPI port which the device is connected to

  cs-gpios:
    type: phandle-array
    required: true
    description: |
      Chip select GPIO

  spi-max-frequency:
    type: int
    required: true
    description: |
      Maximum SPI clocking speed in Hz

  channels:
    type: int
    required: true
    description: |
      Number of sampling channels
```

## application/launchpad_controller/modules/drv8711/Kconfig
```kconfig
config DRV8711
	bool "DRV8711 stepper driver"
	default y
	depends on DT_HAS_TI_DRV8711_ENABLED
	select SPI
	help
		Enable DRV8711 driver.

config DRV8711_DUMMY
	bool "DRV8711 stepper dummy driver"
	default y
	depends on DT_HAS_TI_DRV8711_DUMMY_ENABLED
	help
		Enable dummy DRV8711 driver.

config DRV8711_LOG_LEVEL
    int "Application sensors log level"
    default 0 if DRV8711_LOG_LEVEL_OFF
    default 1 if DRV8711_LOG_LEVEL_ERR
    default 2 if DRV8711_LOG_LEVEL_WRN
    default 3 if DRV8711_LOG_LEVEL_INF
    default 4 if DRV8711_LOG_LEVEL_DBG
    default 2
    depends on LOG
```

## application/launchpad_controller/modules/drv8711/dts/bindings/adc/ti,drv8711.yml
```yaml
# Bindings for AD4111 Analog to Digital Converter (ADC)
# SPDX-License-Identifier: MIT
# Author: Chaitanya Katpatal
# Date: 2024-07-25

description: TI DRV8711 Stepper Motor Driver Driver

compatible: "ti,drv8711"

include: spi-device.yaml

properties:
  # TODO: make current limit more generic and introduce a value denoting the R_ISENSE resistor instead?
  # current-limit-ma:
  #   type: int
  #   required: true
  #   description: |
  #     Stepper Current Limit (in mA) adjusted for Pololu 36v4 Drivers
  step-pin:
    type: phandle
  dir-pin:
    type: phandle
```

## application/launchpad_controller/modules/drv8711/dts/bindings/adc/ti,drv8711_dummy.yml
```yaml
description: Analog to Digital Converter (ADC) driver

compatible: "ti,drv8711-dummy"
```

## application/west.yml
```yaml
manifest:

  defaults:
    remote: zephyrproject

  remotes:
    - name: zephyrproject
      url-base: https://github.com/zephyrproject-rtos


  projects:
    - name: zephyr
      remote: zephyrproject
      # TODO: consider update to f9e3b65d3a9794ee2233aa88172346f887b48d04, will need to change some POSIX API config though.
      revision: v3.7.0
      import:
        path-prefix: deps

  self:
    path: application
```
